## CMakeLists.txt
```
cmake_minimum_required(VERSION 3.20.0)

find_package(Zephyr REQUIRED HINTS $ENV{ZEPHYR_BASE})
project(lpn_mock)

target_sources(app PRIVATE
  src/main.c
  src/model_handler.c
)

zephyr_library_include_directories(.)
```

## Kconfig
```
# Parametry aplikacji LPN Mock sterowane flaga builda (-DCONFIG_...=...).
# Te same symbole co w aplikacji lpn - dla spojnosci pomiarow.

config LPN_SENSOR_INTERVAL_S
	int "Interwal publikacji (fake) temperatury do Frienda [s]"
	default 10
	range 1 86400
	help
	  Odstep miedzy kolejnymi publikacjami Sensor Server -> Friend.
	  Sterowane build-time: -DCONFIG_LPN_SENSOR_INTERVAL_S=<sekundy>.

source "Kconfig.zephyr"
```

## prj.conf
```kconfig
# Logi i konsola: WYLACZONE 
CONFIG_LOG=n
CONFIG_SERIAL=n
CONFIG_CONSOLE=n
CONFIG_UART_CONSOLE=n
CONFIG_RTT_CONSOLE=n
CONFIG_CBPRINTF_FP_SUPPORT=n

# BLE
CONFIG_BT=y
CONFIG_BT_DEVICE_NAME="LPN Mock"
CONFIG_BT_OBSERVER=y
CONFIG_BT_BROADCASTER=y

# Mesh: provisioning REALNY - adres i klucze przychodza od Frienda
CONFIG_BT_MESH=y
CONFIG_BT_MESH_PB_ADV=y

# Rola LPN
CONFIG_BT_MESH_LOW_POWER=y
# 600 x 100 ms = 60 s; keep-alive Friend Poll leci co ~57 s.
CONFIG_BT_MESH_LPN_POLL_TIMEOUT=600
CONFIG_BT_MESH_LPN_RETRY_TIMEOUT=3
# Friendship nawiazywane PELNYM cyklem skanowania (domyslnie zredukowanym).
CONFIG_BT_MESH_LPN_ESTABLISHMENT=n
# Auto-LPN OFF: w tryb LPN wchodzimy recznie, po konfiguracji (patrz main.c).
CONFIG_BT_MESH_LPN_AUTO=n

# Funkcje wymagajace ciagle wlaczonego radia - zbedne dla LPN
CONFIG_BT_MESH_RELAY=n
CONFIG_BT_MESH_FRIEND=n
CONFIG_BT_MESH_BEACON_ENABLED=n
CONFIG_BT_MESH_GATT_PROXY_ENABLED=n

# Sensor Server: jeden czujnik (temperatura - stala, sztuczna wartosc)
CONFIG_BT_MESH_SENSOR_SRV=y
CONFIG_BT_MESH_SENSOR_SRV_SENSORS_MAX=1

# Wezel BEZSTANOWY: po restarcie Friend prowizjonuje go od nowa
CONFIG_BT_SETTINGS=n
CONFIG_SETTINGS=y
CONFIG_FLASH=y
CONFIG_FLASH_MAP=y

# Stosy i bufory
CONFIG_MAIN_STACK_SIZE=4400
CONFIG_MAIN_THREAD_PRIORITY=-2
CONFIG_SYSTEM_WORKQUEUE_STACK_SIZE=4800
CONFIG_BT_MESH_RX_SEG_MAX=32
CONFIG_BT_MESH_TX_SEG_MSG_COUNT=3
# Wiecej buforow adv: wezel odbiera segmenty i jednoczesnie odsyla ACK.
CONFIG_BT_MESH_ADV_BUF_COUNT=16

# SAR RX: prog 1, bo AppKey Add ma 2 segmenty a ACK retransmituje sie gdy > prog
CONFIG_BT_MESH_SAR_RX_SEG_THRESHOLD=0x01
# ACK wysylany 4x - pojedynczy zgubiony ACK konczyl konfiguracje bledem -116.
CONFIG_BT_MESH_SAR_RX_ACK_RETRANS_COUNT=0x03
# Dluzszy discard: niekompletny SDU przezywa okno retransmisji Frienda.
CONFIG_BT_MESH_SAR_RX_DISCARD_TIMEOUT=0x0a

# Odciecie nieuzywanego RAM-u (System ON)
CONFIG_RAM_POWER_DOWN_LIBRARY=y

CONFIG_COMMON_LIBC_MALLOC_ARENA_SIZE=8192
```

## src/main.c
```c
#include <bluetooth/mesh/models.h>
#include <ram_pwrdn.h>
#include <stdint.h>
#include <zephyr/bluetooth/bluetooth.h>
#include <zephyr/bluetooth/mesh.h>
#include <zephyr/kernel.h>
#include <zephyr/logging/log.h>

#include "model_handler.h"

LOG_MODULE_REGISTER(lpn_mock, LOG_LEVEL_INF);

/* UUID w unprovisioned beacon - ten sam co w apps/lpn (mock jest zamiennikiem) */
static const uint8_t dev_uuid[16] = {0x1b, 0x7a, 0x0c, 0x54};

/* W tryb LPN wchodzimy dopiero po konfiguracji - spiacy wezel nie ACK-uje segmentow */
#define CONFIG_POLL_INTERVAL K_SECONDS(2) /* jak czesto sprawdzac stan konfiguracji */
#define CONFIG_SETTLE_DELAY  K_SECONDS(8) /* zapas na retry Frienda po zgubionym Status */

static struct k_work_delayable lpn_start_work;
static bool config_detected;

/* Interwal publikacji temperatury - ustawiany flaga builda (patrz Kconfig) */
#ifndef CONFIG_LPN_SENSOR_INTERVAL_S
#define CONFIG_LPN_SENSOR_INTERVAL_S 10
#endif
#define SENSOR_READ_INTERVAL K_SECONDS(CONFIG_LPN_SENSOR_INTERVAL_S)

static struct k_work_delayable sensor_read_work;

static void sensor_read_work_handler(struct k_work *work)
{
    model_handler_publish_temp();

    /* Przeplanuj siebie - odczyt i publikacja co SENSOR_READ_INTERVAL */
    k_work_reschedule(&sensor_read_work, SENSOR_READ_INTERVAL);
}

/* Czeka az Friend skonfiguruje wezel, odczekuje zapas i wlacza tryb LPN */
static void lpn_start_handler(struct k_work *work)
{
    if (!config_detected) {
        if (!model_handler_is_configured()) {
            /* Konfiguracja jeszcze niekompletna - pytaj dalej */
            k_work_reschedule(&lpn_start_work, CONFIG_POLL_INTERVAL);
            return;
        }

        config_detected = true;
        LOG_INF("Konfiguracja zakonczona (publikacja ustawiona) - za chwile LPN");
        k_work_reschedule(&lpn_start_work, CONFIG_SETTLE_DELAY);
        return;
    }

    /* Konfiguracja gotowa - teraz mozna spac */
    int err = bt_mesh_lpn_set(true);
    if (err) {
        LOG_ERR("Wlaczenie LPN nieudane (err %d)", err);
    }
    else {
        LOG_INF("Tryb LPN wlaczony - szukam Frienda");
    }
}

/* Provisioning zakonczony - wezel ma adres i klucze, czekamy na konfiguracje */
static void prov_complete(uint16_t net_idx, uint16_t addr)
{
    LOG_INF("Sprovisionowany przez Frienda - adres 0x%04x", addr);
    k_work_reschedule(&lpn_start_work, CONFIG_POLL_INTERVAL);
}

static const struct bt_mesh_prov prov = {
    .uuid = dev_uuid,
    .complete = prov_complete,
};

/* Callbacki LPN */
static void lpn_established(uint16_t net_idx, uint16_t friend_addr, uint8_t queue_size,
                            uint8_t recv_window)
{
    LOG_INF("Friendship nawiazany z Friendem 0x%04x (queue %u, recv_window %u ms)", friend_addr,
            queue_size, recv_window);

    /* Rusz cykliczne wysylanie pomiarow */
    k_work_reschedule(&sensor_read_work, K_NO_WAIT);
}

static void lpn_terminated(uint16_t net_idx, uint16_t friend_addr)
{
    LOG_WRN("Friendship zerwany z Friendem 0x%04x", friend_addr);

    /* Brak Frienda - nie ma gdzie publikowac, wiec zatrzymaj pomiary */
    k_work_cancel_delayable(&sensor_read_work);
}

static void lpn_polled(uint16_t net_idx, uint16_t friend_addr, bool retry)
{
    LOG_DBG("Poll do Frienda 0x%04x%s", friend_addr, retry ? " (retry)" : "");
}

BT_MESH_LPN_CB_DEFINE(lpn_cb) = {
    .established = lpn_established,
    .terminated = lpn_terminated,
    .polled = lpn_polled,
};

int main(void)
{
    int err;

    LOG_INF("Start wezla LPN Mock (BTZ_EndDevice, czujnik falszowany)");

    /* Kontrola wkompilowanego Kconfig: LPN_AUTO=1 znaczy, ze prj.conf nie wszedl */
    LOG_INF("KONFIG: LPN_AUTO=%d LOW_POWER=%d (wymagane LPN_AUTO=0)",
            IS_ENABLED(CONFIG_BT_MESH_LPN_AUTO), IS_ENABLED(CONFIG_BT_MESH_LOW_POWER));

    /* Inicjalizacja Bluetooth */
    err = bt_enable(NULL);
    if (err) {
        LOG_ERR("bt_enable nieudany (err %d)", err);
        return 1;
    }

    LOG_INF("Bluetooth zainicjalizowany");

    /* Worki: publikacja pomiarow oraz wejscie w LPN po konfiguracji */
    k_work_init_delayable(&sensor_read_work, sensor_read_work_handler);
    k_work_init_delayable(&lpn_start_work, lpn_start_handler);

    err = bt_mesh_init(&prov, model_handler_init());
    if (err) {
        LOG_ERR("Inicjalizacja mesh nieudana (err %d)", err);
        return 1;
    }

    /* Wystaw unprovisioned beacon i czekaj na provisioning od Frienda */
    err = bt_mesh_prov_enable(BT_MESH_PROV_ADV);
    if (err) {
        LOG_ERR("Wlaczenie provisioningu (beacon) nieudane (err %d)", err);
        return 1;
    }
    LOG_INF("Czekam na provisioning od Frienda...");

    /* Sekcje RAM za obrazem aplikacji nie sa uzywane - odetnij im zasilanie.
     * Wymaga COMMON_LIBC_MALLOC_ARENA_SIZE > 0, inaczej gasilibysmy arene malloc. */
    if (IS_ENABLED(CONFIG_RAM_POWER_DOWN_LIBRARY)) {
        power_down_unused_ram();
    }

    return 0;
}
```

## src/model_handler.c
```c
#include "model_handler.h"

#include <bluetooth/mesh/models.h>
#include <zephyr/bluetooth/bluetooth.h>
#include <zephyr/bluetooth/mesh.h>
#include <zephyr/kernel.h>
#include <zephyr/logging/log.h>

LOG_MODULE_DECLARE(lpn_mock);

/* Health Server */
static const struct bt_mesh_health_srv_cb health_srv_cb; /* puste callbacki */
static struct bt_mesh_health_srv health_srv = {
    .cb = &health_srv_cb,
};

BT_MESH_HEALTH_PUB_DEFINE(health_pub, 0);

/* Sensor Server wersja MOCK: bez STS4X i bez bramki zasilania, stala temperatura */
#define MOCK_TEMP_MICRO_C 22500000 /* 22.5 C */

/* Zwraca sztuczna wartosc w formacie mesh Present Ambient Temperature */
static int temp_sample(struct bt_mesh_sensor_value *rsp)
{
    int err = bt_mesh_sensor_value_from_micro(bt_mesh_sensor_present_amb_temp.channels[0].format,
                                              MOCK_TEMP_MICRO_C, rsp);
    if (err == -ERANGE) {
        err = 0; /* -ERANGE = przycieto do zakresu, OK */
    }
    else if (err) {
        LOG_ERR("Kodowanie wartosci nieudane (err %d)", err);
    }

    return err;
}

/* Callback modelu: wolany, gdy klient wysle Sensor Get */
static int temp_get(struct bt_mesh_sensor_srv *srv, struct bt_mesh_sensor *sensor,
                    struct bt_mesh_msg_ctx *ctx, struct bt_mesh_sensor_value *rsp)
{
    int err = temp_sample(rsp);

    if (!err) {
        LOG_INF("Sensor Get -> temperatura: %s C", bt_mesh_sensor_ch_str(rsp));
    }
    return err;
}

static struct bt_mesh_sensor temp_sensor = {
    .type = &bt_mesh_sensor_present_amb_temp,
    .get = temp_get,
};

static struct bt_mesh_sensor *const sensors[] = {
    &temp_sensor,
};

static struct bt_mesh_sensor_srv sensor_srv = BT_MESH_SENSOR_SRV_INIT(sensors, ARRAY_SIZE(sensors));

/* Kompozycja wezla - identyczna jak w apps/lpn */
static const struct bt_mesh_elem elements[] = {
    BT_MESH_ELEM(0,
                 BT_MESH_MODEL_LIST(BT_MESH_MODEL_CFG_SRV,
                                    BT_MESH_MODEL_HEALTH_SRV(&health_srv, &health_pub),
                                    BT_MESH_MODEL_SENSOR_SRV(&sensor_srv)),
                 BT_MESH_MODEL_NONE),
};

static const struct bt_mesh_comp comp = {
    .cid = BT_COMP_ID_LF,
    .elem = elements,
    .elem_count = ARRAY_SIZE(elements),
};

int model_handler_publish_temp(void)
{
    struct bt_mesh_sensor_value val;
    int err;

    err = temp_sample(&val);
    if (err) {
        return err;
    }

    LOG_INF("Temperatura: %s C", bt_mesh_sensor_ch_str(&val));

    /* Publikacja wartosci czujnika do Frienda */
    err = bt_mesh_sensor_srv_pub(&sensor_srv, NULL, &temp_sensor, &val);
    if (err) {
        LOG_DBG("Publikacja pominieta (err %d) - brak adresu publikacji?", err);
    }

    return err;
}

bool model_handler_is_configured(void)
{
    /* Adres publikacji ustawia ostatni krok konfiguracji Frienda (mod_pub_set) */
    return sensor_srv.pub.addr != BT_MESH_ADDR_UNASSIGNED;
}

const struct bt_mesh_comp *model_handler_init(void)
{
    /* Wersja mock - brak czujnika do inicjalizacji */
    return &comp;
}
```

## src/model_handler.h
```c
#ifndef MODEL_HANDLER_H__
#define MODEL_HANDLER_H__

#include <zephyr/bluetooth/mesh.h>

#ifdef __cplusplus
extern "C" {
#endif

/* Inicjuje modele mesh wezla i zwraca kompozycje */
const struct bt_mesh_comp *model_handler_init(void);

/* Publikuje temperature (mock: stala wartosc) przez Sensor Server */
int model_handler_publish_temp(void);

/* Czy Friend skonczyl konfiguracje - decyduje, kiedy mozna przejsc w tryb LPN */
bool model_handler_is_configured(void);

#ifdef __cplusplus
}
#endif

#endif /* MODEL_HANDLER_H__ */
```
