## CMakeLists.txt
```
cmake_minimum_required(VERSION 3.20.0)

find_package(Zephyr REQUIRED HINTS $ENV{ZEPHYR_BASE})
project(lpn)

target_sources(app PRIVATE
  src/main.c
  src/model_handler.c
)

zephyr_library_include_directories(.)
```

## Kconfig
```
# Parametry aplikacji LPN sterowane flaga builda (-DCONFIG_...=...).
# Kolejne symbole dokladaj tutaj; domyslne wartosci maja nic nie zmieniac.

config LPN_SENSOR_INTERVAL_S
	int "Interwal odczytu i publikacji temperatury do Frienda [s]"
	default 10
	range 1 86400
	help
	  Odstep miedzy kolejnymi publikacjami Sensor Server -> Friend.
	  Sterowane build-time: -DCONFIG_LPN_SENSOR_INTERVAL_S=<sekundy>.

	  Uwaga: niezaleznie od tego LPN polluje Frienda co
	  CONFIG_BT_MESH_LPN_POLL_TIMEOUT (x100 ms).

source "Kconfig.zephyr"
```

## prj.conf
```kconfig
# Logi i konsola: WYLACZONE (UART i watek logow pobieraja prad)
CONFIG_LOG=n
CONFIG_SERIAL=n
CONFIG_CONSOLE=n
CONFIG_UART_CONSOLE=n
# Board defconfig wymusza RTT_CONSOLE=y - gasimy jawnie (jak w apps/baseline).
CONFIG_RTT_CONSOLE=n
# Potrzebne tylko do drukowania floatow w logach (bt_mesh_sensor_ch_str).
CONFIG_CBPRINTF_FP_SUPPORT=n

# BLE
CONFIG_BT=y
CONFIG_BT_DEVICE_NAME="LPN Node"
CONFIG_BT_OBSERVER=y
CONFIG_BT_BROADCASTER=y

# Mesh: provisioning REALNY - adres i klucze przychodza od Frienda
CONFIG_BT_MESH=y
CONFIG_BT_MESH_PB_ADV=y

# Rola LPN
CONFIG_BT_MESH_LOW_POWER=y
# 600 x 100 ms = 60 s; keep-alive Friend Poll leci co ~57 s.
CONFIG_BT_MESH_LPN_POLL_TIMEOUT=600
CONFIG_BT_MESH_LPN_RETRY_TIMEOUT=3
# Friendship nawiazywane PELNYM cyklem skanowania (domyslnie zredukowanym).
CONFIG_BT_MESH_LPN_ESTABLISHMENT=n
# Auto-LPN OFF: w tryb LPN wchodzimy recznie, po konfiguracji (patrz main.c).
CONFIG_BT_MESH_LPN_AUTO=n

# Funkcje wymagajace ciagle wlaczonego radia - zbedne dla LPN
CONFIG_BT_MESH_RELAY=n
CONFIG_BT_MESH_FRIEND=n
CONFIG_BT_MESH_BEACON_ENABLED=n
CONFIG_BT_MESH_GATT_PROXY_ENABLED=n

# Sensor Server: jeden czujnik (temperatura z STS4X)
CONFIG_BT_MESH_SENSOR_SRV=y
CONFIG_BT_MESH_SENSOR_SRV_SENSORS_MAX=1

# Wezel BEZSTANOWY: po restarcie Friend prowizjonuje go od nowa
CONFIG_BT_SETTINGS=n
# Settings/flash zostaja: bez nich blad linkera storage_*_object (PSA ITS na nRF54L).
CONFIG_SETTINGS=y
CONFIG_FLASH=y
CONFIG_FLASH_MAP=y

# Stosy i bufory
CONFIG_MAIN_STACK_SIZE=4400
CONFIG_MAIN_THREAD_PRIORITY=-2
CONFIG_SYSTEM_WORKQUEUE_STACK_SIZE=4800
CONFIG_BT_MESH_RX_SEG_MAX=32
CONFIG_BT_MESH_TX_SEG_MSG_COUNT=3
# Wiecej buforow adv: wezel odbiera segmenty i jednoczesnie odsyla ACK.
CONFIG_BT_MESH_ADV_BUF_COUNT=16

# SAR RX: prog 1, bo AppKey Add ma 2 segmenty a ACK retransmituje sie gdy > prog
CONFIG_BT_MESH_SAR_RX_SEG_THRESHOLD=0x01
# ACK wysylany 4x - pojedynczy zgubiony ACK konczyl konfiguracje bledem -116.
CONFIG_BT_MESH_SAR_RX_ACK_RETRANS_COUNT=0x03
# Dluzszy discard: niekompletny SDU przezywa okno retransmisji Frienda.
CONFIG_BT_MESH_SAR_RX_DISCARD_TIMEOUT=0x0a
# NETWORK_TRANSMIT zostaje DOMYSLNY - podnoszenie go opoznialo ACK i zapychalo adv.

# --- Odciecie nieuzywanego RAM-u (System ON) ---
# Aplikacja zajmuje ~46 kB, czyli sekcje 0-1. Sekcje 2-7 (192 kB z 256 kB)
# traca zasilanie - patrz power_down_unused_ram() w main.c.
CONFIG_RAM_POWER_DOWN_LIBRARY=y
# MUSI byc > 0. Przy -1 arena malloc to caly RAM za obrazem, czyli dokladnie
# to, co gasimy. Dodatnia wartosc przenosi arene do statycznej tablicy w obrazie.
# 8 kB z zapasem: wczesniej malloc mial do dyspozycji caly wolny RAM, a PSA
# potrzebuje sterty przy ECDH w provisioningu. RAM w sekcji 1 i tak zostaje
# zasilony, wiec ta arena nic nie kosztuje energetycznie.
CONFIG_COMMON_LIBC_MALLOC_ARENA_SIZE=8192
```

## boards/BTZ_EndDevice_nrf54l15_cpuapp.overlay
```dts
/*
 * Wylaczamy nieuzywane czujniki, zeby zdjac ten narzut energetyczny.
 */

&ltr329 {
	status = "disabled";
};

&bmi270 {
	status = "disabled";
};

/*
 * STS4X: tryb pomiaru "low"
 */
&sts4x {
	repeatability = <0>;
};
```

## src/main.c
```c
#include <bluetooth/mesh/models.h>
#include <ram_pwrdn.h>
#include <stdint.h>
#include <zephyr/bluetooth/bluetooth.h>
#include <zephyr/bluetooth/mesh.h>
#include <zephyr/kernel.h>
#include <zephyr/logging/log.h>

#include "model_handler.h"

LOG_MODULE_REGISTER(lpn_node, LOG_LEVEL_INF);

/* UUID w unprovisioned beacon - Friend provisionuje tylko ten wezel */
static const uint8_t dev_uuid[16] = {0x1b, 0x7a, 0x0c, 0x54};

/* W tryb LPN wchodzimy dopiero po konfiguracji - spiacy wezel nie ACK-uje segmentow */
#define CONFIG_POLL_INTERVAL K_SECONDS(2) /* jak czesto sprawdzac stan konfiguracji */
#define CONFIG_SETTLE_DELAY  K_SECONDS(8) /* zapas na retry Frienda po zgubionym Status */

static struct k_work_delayable lpn_start_work;
static bool config_detected;

/* Interwal publikacji temperatury - ustawiany flaga builda (patrz Kconfig) */
#ifndef CONFIG_LPN_SENSOR_INTERVAL_S
#define CONFIG_LPN_SENSOR_INTERVAL_S 10
#endif
#define SENSOR_READ_INTERVAL K_SECONDS(CONFIG_LPN_SENSOR_INTERVAL_S)

static struct k_work_delayable sensor_read_work;

static void sensor_read_work_handler(struct k_work *work)
{
    model_handler_publish_temp();

    /* Przeplanuj siebie - odczyt i publikacja co SENSOR_READ_INTERVAL */
    k_work_reschedule(&sensor_read_work, SENSOR_READ_INTERVAL);
}

/* Czeka az Friend skonfiguruje wezel, odczekuje zapas i wlacza tryb LPN */
static void lpn_start_handler(struct k_work *work)
{
    if (!config_detected) {
        if (!model_handler_is_configured()) {
            /* Konfiguracja jeszcze niekompletna - pytaj dalej */
            k_work_reschedule(&lpn_start_work, CONFIG_POLL_INTERVAL);
            return;
        }

        config_detected = true;
        LOG_INF("Konfiguracja zakonczona (publikacja ustawiona) - za chwile LPN");
        k_work_reschedule(&lpn_start_work, CONFIG_SETTLE_DELAY);
        return;
    }

    /* Konfiguracja gotowa - teraz mozna spac */
    int err = bt_mesh_lpn_set(true);
    if (err) {
        LOG_ERR("Wlaczenie LPN nieudane (err %d)", err);
    }
    else {
        LOG_INF("Tryb LPN wlaczony - szukam Frienda");
    }
}

/* Provisioning zakonczony - wezel ma adres i klucze, czekamy na konfiguracje */
static void prov_complete(uint16_t net_idx, uint16_t addr)
{
    LOG_INF("Sprovisionowany przez Frienda - adres 0x%04x", addr);
    k_work_reschedule(&lpn_start_work, CONFIG_POLL_INTERVAL);
}

static const struct bt_mesh_prov prov = {
    .uuid = dev_uuid,
    .complete = prov_complete,
};

/* Callbacki LPN */
static void lpn_established(uint16_t net_idx, uint16_t friend_addr, uint8_t queue_size,
                            uint8_t recv_window)
{
    LOG_INF("Friendship nawiazany z Friendem 0x%04x (queue %u, recv_window %u ms)", friend_addr,
            queue_size, recv_window);

    /* Rusz cykliczne wysylanie pomiarow */
    k_work_reschedule(&sensor_read_work, K_NO_WAIT);
}

static void lpn_terminated(uint16_t net_idx, uint16_t friend_addr)
{
    LOG_WRN("Friendship zerwany z Friendem 0x%04x", friend_addr);

    /* Brak Frienda - nie ma gdzie publikowac, wiec zatrzymaj pomiary */
    k_work_cancel_delayable(&sensor_read_work);
}

static void lpn_polled(uint16_t net_idx, uint16_t friend_addr, bool retry)
{
    LOG_DBG("Poll do Frienda 0x%04x%s", friend_addr, retry ? " (retry)" : "");
}

BT_MESH_LPN_CB_DEFINE(lpn_cb) = {
    .established = lpn_established,
    .terminated = lpn_terminated,
    .polled = lpn_polled,
};

int main(void)
{
    int err;

    LOG_INF("Start wezla LPN (BTZ_EndDevice)");

    /* Kontrola wkompilowanego Kconfig: LPN_AUTO=1 znaczy, ze prj.conf nie wszedl */
    LOG_INF("KONFIG: LPN_AUTO=%d LOW_POWER=%d (wymagane LPN_AUTO=0)",
            IS_ENABLED(CONFIG_BT_MESH_LPN_AUTO), IS_ENABLED(CONFIG_BT_MESH_LOW_POWER));

    /* Inicjalizacja Bluetooth */
    err = bt_enable(NULL);
    if (err) {
        LOG_ERR("bt_enable nieudany (err %d)", err);
        return 1;
    }

    LOG_INF("Bluetooth zainicjalizowany");

    /* Worki: publikacja pomiarow oraz wejscie w LPN po konfiguracji */
    k_work_init_delayable(&sensor_read_work, sensor_read_work_handler);
    k_work_init_delayable(&lpn_start_work, lpn_start_handler);

    err = bt_mesh_init(&prov, model_handler_init());
    if (err) {
        LOG_ERR("Inicjalizacja mesh nieudana (err %d)", err);
        return 1;
    }

    /* Wystaw unprovisioned beacon i czekaj na provisioning od Frienda */
    err = bt_mesh_prov_enable(BT_MESH_PROV_ADV);
    if (err) {
        LOG_ERR("Wlaczenie provisioningu (beacon) nieudane (err %d)", err);
        return 1;
    }
    LOG_INF("Czekam na provisioning od Frienda...");

    /* Sekcje RAM za obrazem aplikacji nie sa uzywane - odetnij im zasilanie.
     * Wymaga COMMON_LIBC_MALLOC_ARENA_SIZE > 0, inaczej gasilibysmy arene malloc. */
    if (IS_ENABLED(CONFIG_RAM_POWER_DOWN_LIBRARY)) {
        power_down_unused_ram();
    }

    return 0;
}
```

## src/model_handler.c
```c
#include "model_handler.h"

#include <bluetooth/mesh/models.h>
#include <zephyr/bluetooth/bluetooth.h>
#include <zephyr/bluetooth/mesh.h>
#include <zephyr/device.h>
#include <zephyr/drivers/regulator.h>
#include <zephyr/drivers/sensor.h>
#include <zephyr/kernel.h>
#include <zephyr/logging/log.h>

LOG_MODULE_DECLARE(lpn_node);

/* Health Server */
static const struct bt_mesh_health_srv_cb health_srv_cb; /* puste callbacki */
static struct bt_mesh_health_srv health_srv = {
    .cb = &health_srv_cb,
};

BT_MESH_HEALTH_PUB_DEFINE(health_pub, 0);

/* Sensor Server (temperatura STS4X) */
static const struct device *const sensor_dev = DEVICE_DT_GET(DT_NODELABEL(sts4x));

/* Bramka zasilania czujnika - wlaczana tylko na czas pomiaru */
static const struct device *const sensor_pwr = DEVICE_DT_GET(DT_NODELABEL(sensor_pwr));
static bool sensor_pwr_ready;

/* Czas na power-up szyny i reset STS4X przed pomiarem */
#define STS4X_POWERUP_MS 2

/* Odczyt z STS4X i zakodowanie do formatu wartosci czujnika mesh */
static int temp_sample(struct bt_mesh_sensor_value *rsp)
{
    struct sensor_value val;
    int err;

    /* Zasilamy szyne czujnika tylko na czas odczytu */
    if (sensor_pwr_ready) {
        err = regulator_enable(sensor_pwr);
        if (err) {
            LOG_ERR("Zalaczenie sensor_pwr nieudane (err %d)", err);
            return err;
        }
        k_msleep(STS4X_POWERUP_MS); /* power-up rail + reset STS4X */
    }

    err = sensor_sample_fetch(sensor_dev);
    if (err) {
        LOG_ERR("sensor_sample_fetch nieudany (err %d)", err);
        goto power_off;
    }

    err = sensor_channel_get(sensor_dev, SENSOR_CHAN_AMBIENT_TEMP, &val);
    if (err) {
        LOG_ERR("sensor_channel_get nieudany (err %d)", err);
        goto power_off;
    }

    /* Konwersja wartosci czujnika do formatu mesh */
    err = bt_mesh_sensor_value_from_sensor_value(bt_mesh_sensor_present_amb_temp.channels[0].format,
                                                 &val, rsp);
    if (err == -ERANGE) {
        err = 0; /* -ERANGE = przycieto do zakresu, OK */
    }
    else if (err) {
        LOG_ERR("Kodowanie wartosci nieudane (err %d)", err);
    }

power_off:
    /* Odetnij zasilanie czujnika */
    if (sensor_pwr_ready) {
        int derr = regulator_disable(sensor_pwr);
        if (derr) {
            LOG_ERR("Wylaczenie sensor_pwr nieudane (err %d)", derr);
        }
    }

    return err;
}

/* Callback modelu: wolany, gdy klient wysle Sensor Get */
static int temp_get(struct bt_mesh_sensor_srv *srv, struct bt_mesh_sensor *sensor,
                    struct bt_mesh_msg_ctx *ctx, struct bt_mesh_sensor_value *rsp)
{
    int err = temp_sample(rsp);

    if (!err) {
        LOG_INF("Sensor Get -> temperatura: %s C", bt_mesh_sensor_ch_str(rsp));
    }
    return err;
}

static struct bt_mesh_sensor temp_sensor = {
    .type = &bt_mesh_sensor_present_amb_temp,
    .get = temp_get,
};

static struct bt_mesh_sensor *const sensors[] = {
    &temp_sensor,
};

static struct bt_mesh_sensor_srv sensor_srv = BT_MESH_SENSOR_SRV_INIT(sensors, ARRAY_SIZE(sensors));

/* Kompozycja wezla */
static const struct bt_mesh_elem elements[] = {
    BT_MESH_ELEM(0,
                 BT_MESH_MODEL_LIST(BT_MESH_MODEL_CFG_SRV,
                                    BT_MESH_MODEL_HEALTH_SRV(&health_srv, &health_pub),
                                    BT_MESH_MODEL_SENSOR_SRV(&sensor_srv)),
                 BT_MESH_MODEL_NONE),
};

static const struct bt_mesh_comp comp = {
    .cid = BT_COMP_ID_LF,
    .elem = elements,
    .elem_count = ARRAY_SIZE(elements),
};

int model_handler_publish_temp(void)
{
    struct bt_mesh_sensor_value val;
    int err;

    err = temp_sample(&val);
    if (err) {
        return err;
    }

    LOG_INF("Temperatura: %s C", bt_mesh_sensor_ch_str(&val));

    /* Publikacja wartosci czujnika do Frienda */
    err = bt_mesh_sensor_srv_pub(&sensor_srv, NULL, &temp_sensor, &val);
    if (err) {
        LOG_DBG("Publikacja pominieta (err %d) - brak adresu publikacji?", err);
    }

    return err;
}

bool model_handler_is_configured(void)
{
    /* Adres publikacji ustawia ostatni krok konfiguracji Frienda (mod_pub_set) */
    return sensor_srv.pub.addr != BT_MESH_ADDR_UNASSIGNED;
}

const struct bt_mesh_comp *model_handler_init(void)
{
    if (!device_is_ready(sensor_dev)) {
        LOG_ERR("STS4X niegotowy - Sensor Server nie bedzie mial danych");
    }

    /* Po inicjalizacji zostawiamy czujnik bez zasilania */
    sensor_pwr_ready = device_is_ready(sensor_pwr);
    if (sensor_pwr_ready) {
        int err = regulator_disable(sensor_pwr);
        if (err) {
            LOG_ERR("Wylaczenie sensor_pwr po init nieudane (err %d)", err);
        }
        else {
            LOG_INF("sensor_pwr OFF - budzony tylko na czas odczytu STS4X");
        }
    }
    else {
        LOG_WRN("sensor_pwr niegotowy - szyna zostanie na stale");
    }

    return &comp;
}
```

## src/model_handler.h
```c
#ifndef MODEL_HANDLER_H__
#define MODEL_HANDLER_H__

#include <zephyr/bluetooth/mesh.h>

#ifdef __cplusplus
extern "C" {
#endif

/* Inicjuje modele mesh wezla i zwraca kompozycje */
const struct bt_mesh_comp *model_handler_init(void);

/* Odczytuje temperature z STS4X i publikuje ja przez Sensor Server */
int model_handler_publish_temp(void);

/* Czy Friend skonczyl konfiguracje - decyduje, kiedy mozna przejsc w tryb LPN */
bool model_handler_is_configured(void);

#ifdef __cplusplus
}
#endif

#endif /* MODEL_HANDLER_H__ */
```
